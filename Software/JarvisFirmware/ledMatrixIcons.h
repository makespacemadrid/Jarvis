#ifndef LEDMATRIXICONS_H
#define LEDMATRIXICONS_H

#include <vector>
#include "ws2812led.h"

#define BIG_FLASH
#ifdef BIG_FLASH


class ledMatrixIcons
{
public:

    static std::vector<uint8_t> wifiGreenIcon16x16()
    {
        static constexpr uint8_t m_wifiGreenIcon16x16[256*3]    = {0,0,0,0,0,0,0,0,0,0,0,0,0,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0,0};
        std::vector<uint8_t> result;
        for(int i = 0 ; i < 256*3 ; i++)
        {
            result.push_back(m_wifiGreenIcon16x16[i]);
        }
        return result;
    }

    static std::vector<std::vector<ws2812Strip::led> > wifiGreenIcon16x16Matrix()
    {
        static constexpr uint8_t wifiGreenIcon16x16[256*3]    = {0,0,0,0,0,0,0,0,0,0,0,0,0,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0,0};
        return convertArrayToLedMatrix(wifiGreenIcon16x16,16,16);
    }

    static std::vector<uint8_t> wifiRedIcon16x16()
    {
        static constexpr uint8_t m_wifiRedIcon16x16[256*3]      = {0,0,0,0,0,0,0,0,0,0,0,0,0,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0,0};
        std::vector<uint8_t> result;
        for(int i = 0 ; i < 256*3 ; i++)
        {
            result.push_back(m_wifiRedIcon16x16[i]);
        }
        return result;
    }

    static std::vector<uint8_t> wifiYellowIcon16x16()
    {
        static constexpr uint8_t m_wifiYellowIcon16x16[256*3]   = {0,0,0,0,0,0,0,0,0,0,0,0,0,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0,0};
        std::vector<uint8_t> result;
        for(int i = 0 ; i < 256*3 ; i++)
        {
            result.push_back(m_wifiYellowIcon16x16[i]);
        }
        return result;
    }

    static std::vector<uint8_t> wifiBlueIcon16x16()
    {
        static constexpr uint8_t m_wifiBlueIcon16x16[256*3]     = {0,0,0,0,0,0,0,0,0,0,0,0,0,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0,0};
        std::vector<uint8_t> result;
        for(int i = 0 ; i < 256*3 ; i++)
        {
            result.push_back(m_wifiBlueIcon16x16[i]);
        }
        return result;
    }

    static std::vector<uint8_t> warningIcon16x16()
    {
        static constexpr uint8_t m_warningIcon16x16[256*3]      = {0,0,0,0,0,0,0,0,0,0,0,0,0,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255,0};
        std::vector<uint8_t> result;
        for(int i = 0 ; i < 256*3 ; i++)
        {
            result.push_back(m_warningIcon16x16[i]);
        }
        return result;
    }


    static std::vector<uint8_t> cylonIcon16x16()
    {
        static constexpr uint8_t m_cylonIcon16x16[256*3]        = {0,0,0,0,0,0,0,0,0,0,0,0,0,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0,0};
        std::vector<uint8_t> result;
        for(int i = 0 ; i < 256*3 ; i++)
        {
            result.push_back(m_cylonIcon16x16[i]);
        }
        return result;
    }


    static std::vector<uint8_t> mMakeSpaceIcon16x16()
    {
        static constexpr uint8_t m_mMakeSpaceIcon16x16[256*3]   = {0,0,0,251,234,0,251,234,0,0,0,0,0,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0,0};
        std::vector<uint8_t> result;
        for(int i = 0 ; i < 256*3 ; i++)
        {
            result.push_back(m_mMakeSpaceIcon16x16[i]);
        }
        return result;
    }
    static std::vector<std::vector<ws2812Strip::led> > makeSpace50x10Matrix()
    {
        static constexpr uint8_t makespaceBigicon[2160] = {0,0,0,0,0,0,255,255,0,255,255,0,0,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0,0} ;
        return convertArrayToLedMatrix(makespaceBigicon,10,72);
    }

    static std::vector<std::vector<ws2812Strip::led> > convertArrayToLedMatrix(const uint8_t* input,uint16_t rows, uint16_t cols)
    {
        //uint16_t arraySize = sizeof(input) / sizeof(uint16_t);
        uint16_t arraySize = cols*rows*3;
        //Serial.print("Array has:");
        //Serial.print(cols);
        //Serial.print("x");
        //Serial.println(rows);

        std::vector<std::vector<ws2812Strip::led> > result;
        uint16_t pos = 0;
        for(int y = 0 ; (y < rows) && (pos < arraySize) ; y++)
        {
            result.push_back(std::vector<ws2812Strip::led>());
            for(int x = 0 ; (x < cols) && (pos < arraySize) ; x++)
            {
                if(arraySize >= pos+3)
                {
                    ws2812Strip::led l;
                    l.setR(input[pos++]);
                    l.setG(input[pos++]);
                    l.setB(input[pos++]);
                    result[y].push_back(l);
                }
            }
        }
        return result;
    }

};


#endif
#endif // LEDMATRIXICONS_H
